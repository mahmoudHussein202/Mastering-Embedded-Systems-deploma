VERSION ""

NS_ :

BS_:

BU_: ECU2_Speed_Sensor ECU1_Accelerator_Manager

BO_ 58 speed_sensor: 1 ECU2_Speed_Sensor
 SG_ Speed_Sensor : 0|8@1+ (1,0) [0|255] ""  ECU1_Accelerator_Manager

BO_ 48 Accelerator_manager: 1 ECU1_Accelerator_Manager
 SG_ Acceleration_Deceleration : 0|8@1+ (1,0) [0|1] ""  ECU2_Speed_Sensor

BA_DEF_  "BusType" STRING ;
BA_DEF_DEF_  "BusType" "";
BA_ "BusType" "CAN";
