VERSION ""

NS_ :

BS_:

BU_: Speed_Sensor ACCELERATOR

BO_ 939 Speed_Val_Message: 1 Speed_Sensor
 SG_ speed : 0|8@1+ (1,0) [0|255] ""  ACCELERATOR

BO_ 48 Accelerator_CMD_Mesage: 1 ACCELERATOR
 SG_ ACC_ON : 0|8@1+ (1,0) [0|1] ""  Speed_Sensor
